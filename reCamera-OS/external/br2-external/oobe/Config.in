## reCamera-OS/external/br2-external/oobe/Config.in
```kconfig
config BR2_PACKAGE_OOBE
    bool "oobe"
    default y
    select BR2_PACKAGE_LIBHV
    help
      Out-of-Box Experience (OOBE) web interface for initial device setup.
      Provides a user-friendly web interface for configuring the device
      on first boot, including network settings and basic configuration.
```

## reCamera-OS/external/br2-external/sscma-camera-detector/Config.in
```kconfig
config BR2_PACKAGE_SSCMA_CAMERA_DETECTOR
    bool "sscma-camera-detector"
    default y
    help
      AI model-based object detection service for reCamera
      Performs real-time object detection using SSCMA-Micro framework
```

## reCamera-OS/external/br2-external/sscma-camera-recorder/Config.in
```kconfig
config BR2_PACKAGE_SSCMA_VIDEO_RECORDER
    bool "sscma-camera-recorder"
    default y
    help
      H.264 video recording service for reCamera
      Provides H.264 video recording to MP4 files for later playback
```

## reCamera-OS/external/br2-external/sscma-camera-streamer/Config.in
```kconfig
config BR2_PACKAGE_SSCMA_CAMERA_STREAMER
    bool "sscma-camera-streamer"
    default y
    help
      WebSocket H.264 camera streaming service for reCamera
      Provides real-time video streaming over WebSocket with H.264 encoding
```

## reCamera-OS/external/buildroot/package/zerotier-one/Config.in
```kconfig
config BR2_PACKAGE_ZEROTIER_ONE
	bool "zerotier-one"
	depends on BR2_INSTALL_LIBSTDCPP
	depends on BR2_TOOLCHAIN_HAS_THREADS_NPTL
	depends on BR2_USE_MMU
	select BR2_PACKAGE_LIBOPENSSL
	help
	  ZeroTier is a software-defined network hypervisor that enables
	  the creation of virtual Ethernet networks that work over
	  physical networks, as if they were connected by a virtual
	  Layer 2 switch.

	  This package installs the zerotier-one daemon and zerotier-cli
	  command line tool.

	  Note: The kernel must have TUN/TAP support enabled
	  (CONFIG_TUN=y or CONFIG_TUN=m).

	  https://www.zerotier.com/

comment "zerotier-one needs a toolchain w/ C++, NPTL"
	depends on BR2_USE_MMU
	depends on !BR2_INSTALL_LIBSTDCPP || !BR2_TOOLCHAIN_HAS_THREADS_NPTL
```

## reCamera-OS/ramdisk/configs/cv181x/multi_sign.its
```
/*
 * U-Boot uImage source file with multiple kernels, ramdisks and FDT blobs
 */

/dts-v1/;

/ {
	description = "Various kernels, ramdisks and FDT blobs";
	#address-cells = <2>;

	images {
		kernel-1 {
			description = "cvitek kernel";
			data = /incbin/("./Image.gz");
			type = "kernel";
			arch = "arm64";
			os = "linux";
			compression = "gzip";
			load = <0x0 0x80080000>;
			entry = <0x0 0x80080000>;
			hash-2 {
				algo = "crc32";
			};
			signature {
				algo = "sha256,rsa2048";
				key-name-hint = "test_reeos";
				required = "image";
				sign-images = "kernel-1";
			};
		};

		ramdisk-1 {
			description = "cvitek ramdisk";
			data = /incbin/("./rootfs.cpio.gz");
			type = "ramdisk";
			arch = "arm64";
			os = "linux";
			compression = "gzip";
			load = <00000000>;
			entry = <00000000>;
			hash-1 {
				algo = "crc32";
			};
			signature {
				algo = "sha256,rsa2048";
				key-name-hint = "test_reeos";
				required = "image";
				sign-images = "ramdisk-1";
			};
		};

		/*FDT*/

	};

	/*CFG*/

};
```
